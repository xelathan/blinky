## CMakeLists.txt
```
# Minimum CMake version
cmake_minimum_required(VERSION 3.22.0)

set(ZEPHYR_EXTRA_MODULES "${CMAKE_SOURCE_DIR}/lib/say_hello")

# Locate the Zephyr RTOS source
find_package(Zephyr REQUIRED HINTS $ENV{ZEPHYR_BASE})

# Name the project
project(blinky)

# Locate the source code for the application
target_sources(app PRIVATE src/main.c)
```

## prj.conf
```kconfig
CONFIG_GPIO=y
CONFIG_DEBUG=y
CONFIG_SAY_HELLO=y
```

## boards/esp32_devkitc_wroom_procpu.overlay
```dts
/ {
    aliases {
        blink-led = &led0;
    };

    leds {
        compatible = "gpio-leds";

        led0: led_0 {
            gpios = <&gpio0 23 GPIO_ACTIVE_HIGH>;
        };
    };
};
```

## boards/nucleo_f446re.overlay
```dts
/ {
    aliases {
        blink-led = &led0;
    };

    leds {
        compatible = "gpio-leds";
        led0: d13 {
            gpios = <&gpioa 5 GPIO_ACTIVE_HIGH>;
			label = "BLINK_LED";
        };
    };
};
```

## src/main.c
```c
#include <zephyr/kernel.h>
#include <zephyr/drivers/gpio.h>
#include <zephyr/sys/printk.h>

#ifdef CONFIG_SAY_HELLO
#include "say_hello.h"
#endif

#define BLINK_DELAY 1000
#define BLINK_LED_NODE DT_ALIAS(blink_led)

static const struct gpio_dt_spec led = GPIO_DT_SPEC_GET(BLINK_LED_NODE, gpios);

void work_handler(struct k_work* work);
void timer_handler(struct k_timer* timer);

K_WORK_DEFINE(my_work, work_handler);
K_TIMER_DEFINE(my_timer, timer_handler, NULL);

void work_handler(struct k_work* work) {
    int ret;

    ret = gpio_pin_toggle_dt(&led);
    if (ret < 0) {
        printk("Failed to toggle LED\r\n");
    }

    printk("Work flags: %d\r\n", work->flags);
#ifdef CONFIG_SAY_HELLO
    say_hello();
#endif
}

void timer_handler(struct k_timer* timer) {
    printk("Timer status: %d\r\n", timer->status);
    k_work_submit(&my_work);
}

int main(void) {
    int ret;

    if (!gpio_is_ready_dt(&led)) {
        printk("GPIO not ready\r\n");
        return 0;
    }

    ret = gpio_pin_configure_dt(&led, GPIO_OUTPUT_ACTIVE);

    if (ret < 0) {
        printk("Failed configure GPIO\r\n");
        return 0;
    }

    k_timer_start(&my_timer, K_MSEC(10000), K_MSEC(BLINK_DELAY));
}
```
